## lib/Kconfig.khp
```kconfig
config HAVE_ARCH_KHP
  bool

if HAVE_ARCH_KHP

config KHP_PUREINST
  bool "KHP: kernel heap protector (pure instrumentation)"
  depends on !KASAN
  help
    Enables basic kernel heap protector infrastructure.
    This has no effect other than slowing down your kernel unless you also
    enable CONFIG_KHP.

config KHP
  bool "KHP: kernel heap protector"
  depends on KHP_PUREINST && SLUB
  select RANDOMIZE_BASE
  select CONTEXT_TRACKING
  select CONTEXT_TRACKING_FORCE
  help
    Enables kernel heap protector - runtime memory protection, designed to
    prevent exploitation of use-after-free issues and some cases of heap
    overflows. This feature causes about a ~XX% performance slowdown.

config KHP_DEBUG
  bool "KHP: enable slow debug features"
  depends on KHP
  help
    Enable slow debugging code for the Kernel Heap Protector.

config KHP_DEBUG_DEPLETE_FASTER
  bool "KHP: Artificially exhaust cookie space faster for internal debugging"
  depends on KHP
  help
    This reduces the cookie space per allocation from 0x10000 to 0x100 to aid in
    debugging problems in KHP's fallback logic for exhausted allocations.

    Do not enable this unless you know what you're doing - this will reduce
    performance and cause your system to run out of memory fairly quickly.

endif
```
